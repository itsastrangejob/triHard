## boards/shields/triHard/Kconfig.shield
```kconfig
# Copyright (c) 2022 The ZMK Contributors
# SPDX-License-Identifier: MIT

config SHIELD_TRIHARD
   def_bool $(shields_list_contains,trihard)

CONFIG_ZMK_SLEEP=y
```
